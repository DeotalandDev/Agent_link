## main/Kconfig.projbuild
```kconfig
menu "Agent Link Device"

choice BOARD_TYPE
    prompt "Board Type"
    default BOARD_TYPE_ROROLEE_S3
    help
        This option only decides "which board to compile",NOT the target chip,Different boards may use different chips
        Adding a new board:  see boards/README.md
    config BOARD_TYPE_ROROLEE_S3
        bool "RoRoLee-S3 (ESP32-S3)"

    config BOARD_TYPE_ESP32P4_WAVESHARE
        bool "ESP32-P4 Waveshare (CO5300 466x466 AMOLED)"
    config BOARD_TYPE_ESP32S3_TEM_MONITOR
        bool "ESP32-S3 TemMonitor (Pressure_Temp_Humidity_Monitor)"
    config BOARD_TYPE_ESP32S3_ES8311_VOICE
        bool "ESP32-S3 ES8311 Voice (single-codec audio example)"
    config BOARD_TYPE_ESP32S3_ES8311_ASR
        bool "ESP32-S3 ES8311 ASR (minimal real-time ASR example)"
    config BOARD_TYPE_ESP32S3_GC2145_CAMERA
        bool "ESP32-S3 GC2145 Camera (DVP camera preview on ST7789 LCD)"
    config BOARD_TYPE_ESP32S3_ROROLEE_BASIC
        bool "ESP32-S3 RoRoLee Basic (rorolee-basic board with ES8311 audio, SH8501 display, SD card, and buttons)"
endchoice

choice AGENT_LINK_TRANSPORT
    prompt "Transport backend"
    default AGENT_LINK_TRANSPORT_BLE
    help
        How the device reaches the Deotaland Agent platform
        BLE:  connect to the phone App over Bluetooth (the App relays to the cloud)
        WiFi: join a WiFi network: first run brings up a SoftAP captive portal to enter the WiFi credentials
    config AGENT_LINK_TRANSPORT_BLE
        bool "BLE"
    config AGENT_LINK_TRANSPORT_WIFI
        bool "WiFi"
endchoice

endmenu
```

## sdkconfig.defaults
```kconfig
CONFIG_LOG_DEFAULT_LEVEL_INFO=y
CONFIG_BT_ENABLED=y
CONFIG_BT_NIMBLE_ENABLED=y
CONFIG_BT_NIMBLE_L2CAP_COC_MAX_NUM=2
CONFIG_BT_NIMBLE_NVS_PERSIST=y
CONFIG_BT_NIMBLE_LOG_LEVEL_WARNING=y
CONFIG_ESPTOOLPY_FLASHSIZE_16MB=y
CONFIG_PARTITION_TABLE_CUSTOM=y
CONFIG_PARTITION_TABLE_CUSTOM_FILENAME="partitions.csv"
```

## sdkconfig.defaults.esp32p4
```kconfig
CONFIG_SPIRAM=y
CONFIG_SPIRAM_MODE_HEX=y
CONFIG_SPIRAM_SPEED_200M=y
CONFIG_ESPTOOLPY_FLASHSIZE_16MB=y
CONFIG_COMPILER_OPTIMIZATION_PERF=y
```
